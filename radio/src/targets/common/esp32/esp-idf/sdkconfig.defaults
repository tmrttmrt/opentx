## radio/src/targets/common/esp32/esp-idf/sdkconfig.defaults
```kconfig
CONFIG_PARTITION_TABLE_CUSTOM=y
CONFIG_PARTITION_TABLE_CUSTOM_FILENAME="partitions.csv"
CONFIG_PARTITION_TABLE_CUSTOM_APP_BIN_OFFSET=0x10000
CONFIG_PARTITION_TABLE_FILENAME="partitions.csv"
CONFIG_APP_OFFSET=0x10000
CONFIG_ESPTOOLPY_FLASHSIZE_4MB=y
CONFIG_FATFS_CODEPAGE_437=y
CONFIG_FATFS_MAX_LFN=255
CONFIG_FATFS_LFN_HEAP=y
```

## radio/src/targets/esp-heltec-32/esp-idf/sdkconfig.defaults
```kconfig
CONFIG_PARTITION_TABLE_CUSTOM=y
CONFIG_PARTITION_TABLE_CUSTOM_FILENAME="radio/src/targets/common/esp32/esp-idf/partitions.csv"
CONFIG_PARTITION_TABLE_CUSTOM_APP_BIN_OFFSET=0x10000
CONFIG_APP_OFFSET=0x10000
CONFIG_ESPTOOLPY_FLASHSIZE_4MB=y
CONFIG_FATFS_CODEPAGE_437=y
CONFIG_FATFS_MAX_LFN=255
CONFIG_FATFS_LFN_HEAP=y
CONFIG_FATFS_FS_LOCK=8
CONFIG_ESPTOOLPY_BAUD_921600B=y
CONFIG_ESPTOOLPY_BAUD=921600
CONFIG_FATFS_API_ENCODING_UTF_8=y
CONFIG_FREERTOS_HZ=500
CONFIG_ESP32_XTAL_FREQ=26
CONFIG_ESP32_XTAL_FREQ_26=y
```
